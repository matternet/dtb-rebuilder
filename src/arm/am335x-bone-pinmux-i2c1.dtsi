/*
 * Copyright (C) 2012 Texas Instruments Incorporated - http://www.ti.com/
 *
 * This program is free software; you can redistribute it and/or modify
 * it under the terms of the GNU General Public License version 2 as
 * published by the Free Software Foundation.
 */

#include <dt-bindings/board/am335x-bbw-bbb-base.h>
#include "am335x-peripheral-i2c1.dtsi"

/* cape universal */

/*
 *&ocp {
 *	P9_17_pinmux {
 *		mode = "i2c";
 *	};
 *	P9_18_pinmux {
 *		mode = "i2c";
 *	};
 *};
 *
 */

/* standard */

&am33xx_pinmux {
	i2c1_pins: pinmux_i2c1_pins {
		pinctrl-single,pins = <
                        /* spi0_d1.i2c1_sda, SLEWCTRL_SLOW | INPUT_PULLUP | MODE2 */
                        BONE_P9_18 (PIN_INPUT_PULLUP | SLEWCTRL_FAST | MUX_MODE2)
                        /* spi0_cs0.i2c1_scl, SLEWCTRL_SLOW | INPUT_PULLUP | MODE2 */
                        BONE_P9_17 (PIN_INPUT_PULLUP | SLEWCTRL_FAST | MUX_MODE2)
		>;
	};
};

&i2c1 {
	pinctrl-0 = <&i2c1_pins>;
};
